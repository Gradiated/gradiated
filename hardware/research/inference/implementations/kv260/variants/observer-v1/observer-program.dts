// Full PL programming only. A separate, already-verified clock overlay remains.
/dts-v1/;
/plugin/;
/ {
    fragment@0 {
        target = <&fpga_full>;
        __overlay__ {
            firmware-name = "gradiated-tiny-observer-v1-50mhz.bit.bin";
            resets = <&zynqmp_reset 119>; // Generated pl_resetn0 is EMIO95.
        };
    };
};
